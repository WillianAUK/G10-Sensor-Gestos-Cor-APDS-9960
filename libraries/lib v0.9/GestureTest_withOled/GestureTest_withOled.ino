/****************************************************************


Tests the gesture sensing abilities of the APDS-9960. Configures
APDS-9960 over I2C and waits for gesture events. Calculates the
direction of the swipe (up, down, left, right) and displays it
on a serial console. 

To perform a NEAR gesture, hold your hand
far above the sensor and move it close to the sensor (within 2
inches). Hold your hand there for at least 1 second and move it
away.

To perform a FAR gesture, hold your hand within 2 inches of the
sensor for at least 1 second and then move it above (out of
range) of the sensor.

Hardware Connections:

IMPORTANT: The APDS-9960 can only accept 3.3V!
 
 wemos D1 mini Pin  APDS-9960 Board  Function
 
 3.3V         VCC              Power
 GND          GND              Ground
 D2           SDA              I2C Data
 D1           SCL              I2C Clock
 D6           INT              Interrupt


****************************************************************/

#include <Wire.h>
#include <SparkFun_APDS9960.h>

#include <Adafruit_GFX.h>
#include <Adafruit_SSD1306.h>

// Pins on wemos D1 mini
#define APDS9960_SDA    4  //GPIO4 (D2)
#define APDS9960_SCL    5  //GPIO5 (D1)
// Constants
const byte APDS9960_INT  = 12; //GPIO12 (D6)



///oled
#define SCREEN_WIDTH 128    // OLED display width, in pixels
#define SCREEN_HEIGHT 64    // OLED display height, in pixels
#define OLED_RESET -1        // Reset pin # (or -1 if sharing Arduino reset pin)
Adafruit_SSD1306 display(SCREEN_WIDTH, SCREEN_HEIGHT, &Wire, OLED_RESET);

#define LOGO_HEIGHT   64
#define LOGO_WIDTH    64
static const unsigned char PROGMEM myleft[] =
{ 
  0x45, 0x45, 0x45, 0xff,   /*Color of index 0*/
  0xe9, 0xea, 0xe9, 0xff,   /*Color of index 1*/
 
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  0xff, 0xff, 0xff, 0xff, 0xff, 0xff, 0xff, 0xff, 
};
 
static const unsigned char PROGMEM myright[] =
{ 0x33, 0x34, 0x33, 0xff,   /*Color of index 0*/
  0xec, 0xed, 0xec, 0xff,   /*Color of index 1*/
 
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  0xff, 0xff, 0xff, 0xff, 0xff, 0xff, 0xff, 0xff, 
};
 
 
static const unsigned char PROGMEM myup[] =
{ 0x2d, 0x2d, 0x2d, 0xff,   /*Color of index 0*/
  0xf5, 0xf6, 0xf5, 0xff,   /*Color of index 1*/
 
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  0xff, 0xff, 0xff, 0xff, 0xff, 0xff, 0xff, 0xff, 
};
 
 
static const unsigned char PROGMEM mydown[] =
{ 0x3f, 0x3f, 0x3f, 0xff,   /*Color of index 0*/
  0xea, 0xeb, 0xea, 0xff,   /*Color of index 1*/
 
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  0xff, 0xff, 0xff, 0xff, 0xff, 0xff, 0xff, 0xff, 
};
 
static const unsigned char PROGMEM mynear[] =
{ 0x59, 0x59, 0x59, 0xff,   /*Color of index 0*/
  0xf8, 0xf9, 0xf8, 0xff,   /*Color of index 1*/
 
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  0xff, 0xff, 0xff, 0xff, 0xff, 0xff, 0xff, 0xff, 
};
 
 
static const unsigned char PROGMEM myfar[] =
{ 0x63, 0x64, 0x63, 0xff,   /*Color of index 0*/
  0xf8, 0xfa, 0xf8, 0xff,   /*Color of index 1*/
 
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  0xff, 0xff, 0xff, 0xff, 0xff, 0xff, 0xff, 0xff, 
};
 
 
 

// Global Variables
SparkFun_APDS9960 apds = SparkFun_APDS9960();
volatile bool isr_flag = 0;

//Interrupt callback function in IRAM
void ICACHE_RAM_ATTR interruptRoutine ();

void setup() {
   //Start I2C with pins defined above
  Wire.begin(APDS9960_SDA,APDS9960_SCL);

  // Set interrupt pin as input
  pinMode(digitalPinToInterrupt(APDS9960_INT), INPUT);
  //delay(250);
  // Initialize Serial port
  Serial.begin(9600);
  Serial.println();
  Serial.println(F("--------------------------------"));
  Serial.println(F("SparkFun APDS-9960 - GestureTest"));
  Serial.println(F("--------------------------------"));

  display.begin(SSD1306_SWITCHCAPVCC, 0x3C); //initialize with the I2C addr 0x3C (128x64)

  
  // Initialize interrupt service routine
  attachInterrupt(digitalPinToInterrupt(APDS9960_INT), interruptRoutine, FALLING);

  // Initialize APDS-9960 (configure I2C and initial values)
  if ( apds.init() ) {
    Serial.println(F("APDS-9960 initialization complete"));
    display.clearDisplay();
    display.setCursor(0,0);  
    display.setTextSize(1);
    display.setTextColor(WHITE);
    display.println("ADPS Initialization");
    display.println("");
    display.setTextSize(2);
    display.println("Success! ");
    display.display();
  } else {
    Serial.println(F("Something went wrong during APDS-9960 init!"));
    display.clearDisplay();
    display.setCursor(0,0);  
    display.setTextSize(1);
    display.setTextColor(WHITE);
    display.println("ADPS Initialization");
    display.println("");
    display.setTextSize(2);
    display.println("Failed! ");
    display.display();
  }
  
  // Start running the APDS-9960 gesture sensor engine
  if ( apds.enableGestureSensor(true) ) {
    Serial.println(F("Gesture sensor is now running"));
    display.clearDisplay();
    display.setCursor(0,0);  
    display.setTextSize(1);
    display.setTextColor(WHITE);
    display.println("ADPS Initialization");
    display.println("");
    display.setTextSize(2);
    display.println("Success! ");
    display.display();
  } else {
    Serial.println(F("Something went wrong during gesture sensor init!"));
    display.clearDisplay();
    display.setCursor(0,0);  
    display.setTextSize(1);
    display.setTextColor(WHITE);
    display.println("ADPS Initialization");
    display.println("");
    display.setTextSize(2);
    display.println("Failed! ");
    display.display();
  }
}

void loop() {
  if( isr_flag == 1 ) {
    detachInterrupt(digitalPinToInterrupt(APDS9960_INT));
    handleGesture();    
    isr_flag = 0;
    attachInterrupt(digitalPinToInterrupt(APDS9960_INT), interruptRoutine, FALLING);
  }
}

void interruptRoutine() {
  isr_flag = 1;
}

void handleGesture() {
    if ( apds.isGestureAvailable() ) {
    switch ( apds.readGesture() ) {
      case DIR_UP:
        Serial.println("UP");
        display.clearDisplay();
        display.drawBitmap(31, 0, myup, LOGO_WIDTH, LOGO_HEIGHT, 1);
        display.display();
        break;
      case DIR_DOWN:
        Serial.println("DOWN");
        display.clearDisplay();
        display.drawBitmap(31, 0, mydown, LOGO_WIDTH, LOGO_HEIGHT, 1);
        display.display();
        break;
      case DIR_LEFT:
        Serial.println("LEFT");
        display.clearDisplay();
        display.drawBitmap(31, 0, myleft, LOGO_WIDTH, LOGO_HEIGHT, 1);
        display.display();
        break;
      case DIR_RIGHT:
        Serial.println("RIGHT");
        display.clearDisplay();
        display.drawBitmap(31, 0, myright, LOGO_WIDTH, LOGO_HEIGHT, 1);
        display.display();
        break;
      case DIR_NEAR:
        Serial.println("NEAR");
        display.clearDisplay();
        display.drawBitmap(31, 0, mynear, LOGO_WIDTH, LOGO_HEIGHT, 1);
        display.display();
        break;
      case DIR_FAR:
        Serial.println("FAR");
        display.clearDisplay();
        display.drawBitmap(31, 0, myfar, LOGO_WIDTH, LOGO_HEIGHT, 1);
        display.display();
        break;
      default:
        Serial.println("NONE");
    }
  }
 
}
